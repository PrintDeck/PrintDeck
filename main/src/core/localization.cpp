#include "printdeck/core/localization.hpp"

#include <array>
#include <cctype>
#include <string>

namespace printdeck::core {

bool supported_language(std::string_view code) {
  for (const Language& language : kLanguages) {
    if (language.code == code) return true;
  }
  return false;
}

std::string_view normalize_language(std::string_view browser_language) {
  std::string normalized(browser_language);
  for (char& character : normalized) {
    if (character == '_') character = '-';
    else character = static_cast<char>(std::tolower(static_cast<unsigned char>(character)));
  }
  if (normalized.rfind("pl", 0) == 0) return "pl";
  if (normalized.rfind("es", 0) == 0) return "es";
  if (normalized.rfind("fr", 0) == 0) return "fr";
  if (normalized.rfind("de", 0) == 0) return "de";
  if (normalized.rfind("zh", 0) == 0) return "zh-CN";
  return "en";
}

const char* localized_text(std::string_view language, std::string_view english) {
  struct Entry { const char* en; const char* pl; const char* es; const char* fr; const char* de; const char* zh; };
  static constexpr Entry entries[]{
      {"Starting device services", "Uruchamianie usług", "Iniciando servicios", "Démarrage des services", "Gerätedienste starten", "正在启动设备服务"},
      {"QUICK MENU", "SZYBKIE MENU", "MENÚ RÁPIDO", "MENU RAPIDE", "SCHNELLMENÜ", "快捷菜单"},
      {"DISPLAY & BRIGHTNESS", "EKRAN I JASNOŚĆ", "PANTALLA Y BRILLO", "ÉCRAN ET LUMINOSITÉ", "DISPLAY UND HELLIGKEIT", "显示与亮度"},
      {"BRIGHTNESS", "JASNOŚĆ", "BRILLO", "LUMINOSITÉ", "HELLIGKEIT", "亮度"},
      {"THEME", "MOTYW", "TEMA", "THÈME", "DESIGN", "主题"},
      {"PRINTER ANIMATIONS", "ANIMACJE DRUKARKI", "ANIMACIONES DE IMPRESORA", "ANIMATIONS DE L’IMPRIMANTE", "DRUCKERANIMATIONEN", "打印机动画"},
      {"SOUNDS", "DŹWIĘKI", "SONIDOS", "SONS", "TÖNE", "声音"},
      {"AUDIO", "DŹWIĘK", "SONIDO", "SON", "TON", "声音"},
      {"WI-FI ERROR", "BŁĄD WI-FI", "ERROR DE WI-FI", "ERREUR WI-FI", "WLAN-FEHLER", "Wi-Fi 错误"},
      {"WI-FI SETUP", "WI-FI SETUP", "WI-FI SETUP", "WI-FI SETUP", "WI-FI SETUP", "WI-FI SETUP"},
      {"LANGUAGE", "JĘZYK", "IDIOMA", "LANGUE", "SPRACHE", "语言"},
      {"MY PRINTERS", "MOJE DRUKARKI", "MIS IMPRESORAS", "MES IMPRIMANTES", "MEINE DRUCKER", "我的打印机"},
      {"No printers added yet", "Nie dodano jeszcze drukarek", "Aún no hay impresoras", "Aucune imprimante ajoutée", "Noch keine Drucker", "尚未添加打印机"},
      {"Open Web Config to add your first printer", "Otwórz Web Config, aby dodać drukarkę", "Abre Web Config para añadir una impresora", "Ouvrez Web Config pour ajouter une imprimante", "Web Config öffnen und Drucker hinzufügen", "打开 Web Config 添加打印机"},
      {"WEB CONFIG URL", "ADRES WEB CONFIG", "URL DE WEB CONFIG", "URL DE WEB CONFIG", "WEB-CONFIG-URL", "WEB CONFIG 地址"},
      {"Use a device on the same Wi-Fi network", "Użyj urządzenia w tej samej sieci Wi-Fi", "Usa un dispositivo en la misma red Wi-Fi", "Utilisez un appareil sur le même réseau Wi-Fi", "Gerät im selben WLAN verwenden", "请使用同一 Wi-Fi 网络中的设备"},
      {"LOCAL CAMERA", "KAMERA LOKALNA", "CÁMARA LOCAL", "CAMÉRA LOCALE", "LOKALE KAMERA", "本地摄像头"},
      {"CAMERA", "KAMERA", "CÁMARA", "CAMÉRA", "KAMERA", "摄像头"},
      {"PRINTER LIGHT", "OŚWIETLENIE DRUKARKI", "LUZ DE IMPRESORA", "ÉCLAIRAGE IMPRIMANTE", "DRUCKERLICHT", "打印机照明"},
      {"SYSTEM DETAILS", "SZCZEGÓŁY SYSTEMU", "DETALLES DEL SISTEMA", "DÉTAILS DU SYSTÈME", "SYSTEMDETAILS", "系统详情"},
      {"SYSTEM", "SYSTEM", "SISTEMA", "SYSTÈME", "SYSTEM", "系统"},
      {"NETWORK", "SIEĆ", "RED", "RÉSEAU", "NETZWERK", "网络"},
      {"PRINTERS", "DRUKARKI", "IMPRESORAS", "IMPRIMANTES", "DRUCKER", "打印机"},
      {"UPDATE AVAILABLE", "DOSTĘPNA AKTUALIZACJA", "ACTUALIZACIÓN DISPONIBLE", "MISE À JOUR DISPONIBLE", "UPDATE VERFÜGBAR", "有可用更新"},
      {"UPDATE NOW", "AKTUALIZUJ", "ACTUALIZAR AHORA", "METTRE À JOUR", "JETZT AKTUALISIEREN", "立即更新"},
      {"UPDATE FAILED", "BŁĄD AKTUALIZACJI", "ERROR DE ACTUALIZACIÓN", "ÉCHEC DE LA MISE À JOUR", "UPDATE FEHLGESCHLAGEN", "更新失败"},
      {"INSTALLING UPDATE", "INSTALOWANIE AKTUALIZACJI", "INSTALANDO ACTUALIZACIÓN", "INSTALLATION DE LA MISE À JOUR", "UPDATE WIRD INSTALLIERT", "正在安装更新"},
      {"RETRY", "PONÓW", "REINTENTAR", "RÉESSAYER", "ERNEUT VERSUCHEN", "重试"},
      {"DEVICE TEMP", "TEMP. URZĄDZENIA", "TEMP. DISPOSITIVO", "TEMP. APPAREIL", "GERÄTETEMP.", "设备温度"},
      {"INTERNAL", "PAMIĘĆ WEWN.", "MEMORIA INTERNA", "MÉMOIRE INTERNE", "INTERNER SPEICHER", "内部内存"},
      {"SOUND", "DŹWIĘK", "SONIDO", "SON", "TON", "声音"},
      {"CHARGING", "ŁADOWANIE", "CARGANDO", "EN CHARGE", "WIRD GELADEN", "正在充电"},
      {"USB POWER", "ZASILANIE USB", "ALIMENTACIÓN USB", "ALIMENTATION USB", "USB-STROM", "USB 供电"},
      {"BATTERY POWER", "ZASILANIE Z BATERII", "ALIMENTACIÓN POR BATERÍA", "ALIMENTATION BATTERIE", "BATTERIEBETRIEB", "电池供电"},
      {"POWER STATUS UNAVAILABLE", "BRAK STANU ZASILANIA", "ESTADO DE ENERGÍA NO DISPONIBLE", "ÉTAT D’ALIMENTATION INDISPONIBLE", "STROMSTATUS NICHT VERFÜGBAR", "电源状态不可用"},
      {"OFFLINE", "OFFLINE", "SIN CONEXIÓN", "HORS LIGNE", "OFFLINE", "离线"},
      {"UPTIME", "CZAS PRACY", "TIEMPO ACTIVO", "TEMPS ACTIF", "LAUFZEIT", "运行时间"},
      {"Version", "Wersja", "Versión", "Version", "Version", "版本"},
      {"Checking for updates...", "Sprawdzanie aktualizacji...", "Buscando actualizaciones...", "Recherche de mises à jour...", "Suche nach Updates...", "正在检查更新..."},
      {"Update available", "Dostępna aktualizacja", "Actualización disponible", "Mise à jour disponible", "Update verfügbar", "有可用更新"},
      {"available", "dostępna", "disponible", "disponible", "verfügbar", "可用"},
      {"Update check failed\nTap to retry", "Błąd sprawdzania aktualizacji\nDotknij, aby ponowić", "Error al buscar actualizaciones\nToca para reintentar", "Échec de la recherche\nTouchez pour réessayer", "Update-Prüfung fehlgeschlagen\nZum Wiederholen tippen", "检查更新失败\n轻触重试"},
      {"Up to date", "Aktualne", "Actualizado", "À jour", "Aktuell", "已是最新版本"},
      {"No update for this hardware", "Brak aktualizacji dla tego sprzętu", "No hay actualización para este hardware", "Aucune mise à jour pour ce matériel", "Kein Update für diese Hardware", "此硬件暂无更新"},
      {"Installing update...", "Instalowanie aktualizacji...", "Instalando actualización...", "Installation de la mise à jour...", "Update wird installiert...", "正在安装更新..."},
      {"Restarting...", "Ponowne uruchamianie...", "Reiniciando...", "Redémarrage...", "Neustart...", "正在重启..."},
      {"Backing up...", "Tworzenie kopii...", "Creando copia...", "Sauvegarde...", "Sicherung läuft...", "正在备份..."},
      {"Restoring backup...", "Przywracanie kopii...", "Restaurando copia...", "Restauration...", "Sicherung wird wiederhergestellt...", "正在恢复备份..."},
      {"LOADING", "ŁADOWANIE", "CARGANDO", "CHARGEMENT", "LADEN", "加载中"},
      {"MUTED", "WYCISZONO", "SILENCIADO", "MUET", "STUMM", "已静音"},
      {"SOUND SET", "ZESTAW", "ESTILO", "STYLE SONORE", "KLANGSTIL", "声音风格"},
      {"MODERN", "MODERN", "MODERNO", "MODERNE", "MODERN", "现代"},
      {"SOFT", "ŁAGODNY", "SUAVE", "DOUX", "SANFT", "柔和"},
      {"RETRO", "RETRO", "RETRO", "RÉTRO", "RETRO", "复古"},
      {"ARCADE", "ARCADE", "ARCADE", "ARCADE", "ARCADE", "街机"},
      {"SCI-FI", "SCI-FI", "SCI-FI", "SCI-FI", "SCI-FI", "科幻"},
      {"VOICE", "GŁOS", "VOZ", "VOIX", "STIMME", "语音"},
      {"CHOOSE THEME", "WYBIERZ MOTYW", "ELIGE UN TEMA", "CHOISISSEZ UN THÈME", "DESIGN WÄHLEN", "选择主题"},
      {"GREEN", "ZIELONY", "VERDE", "VERT", "GRÜN", "绿色"},
      {"SUNSET", "ZACHÓD", "ATARDECER", "COUCHER", "SONNENUNTERGANG", "日落"},
      {"ICE", "LÓD", "HIELO", "GLACE", "EIS", "冰霜"},
      {"CYBER", "CYBER", "CIBER", "CYBER", "CYBER", "赛博"},
      {"FOREST", "LAS", "BOSQUE", "FORÊT", "WALD", "森林"},
      {"MONO", "MONO", "MONO", "MONO", "MONO", "单色"},
      {"CRIMSON", "KARMAZYN", "CARMESÍ", "CRAMOISI", "KARMIN", "绯红"},
      {"SIGNAL", "SYGNAŁ", "SEÑAL", "SIGNAL", "SIGNAL", "信号"},
      {"BANANA", "BANANA", "BANANA", "BANANA", "BANANA", "BANANA"},
      {"SOLSTICE", "PRZESILENIE", "SOLSTICIO", "SOLSTICE", "SONNENWENDE", "至日"},
      {"GLACIER", "LODOWIEC", "GLACIAR", "GLACIER", "GLETSCHER", "冰川"},
      {"AURORA", "ZORZA", "AURORA", "AURORE", "AURORA", "极光"},
      {"GROVE", "GAJ", "ARBOLEDA", "BOSQUET", "HAIN", "林间"},
      {"GRAPHITE", "GRAFIT", "GRAFITO", "GRAPHITE", "GRAPHIT", "石墨"},
      {"GARNET", "GRANAT", "GRANATE", "GRENAT", "GRANAT", "石榴红"},
      {"MIDNIGHT HALO", "MIDNIGHT HALO", "MIDNIGHT HALO", "MIDNIGHT HALO", "MIDNIGHT HALO", "MIDNIGHT HALO"},
      {"DRAGON", "SMOK", "DRAGÓN", "DRAGON", "DRACHE", "赤龙"},
      {"TERMINAL", "TERMINAL", "TERMINAL", "TERMINAL", "TERMINAL", "终端"},
      {"HALO", "HALO", "HALO", "HALO", "HALO", "HALO"},
      {"TERM", "TERM", "TERM", "TERM", "TERM", "终端"},
      {"CUSTOM", "WŁASNY", "PERSONALIZADO", "PERSONNALISÉ", "EIGENES", "自定义"},
      {"Keep holding POWER", "Trzymaj przycisk POWER", "Mantén pulsado POWER", "Maintenez POWER", "POWER gedrückt halten", "继续按住电源键"},
      {"POWERING OFF", "WYŁĄCZANIE", "APAGANDO", "ARRÊT", "WIRD AUSGESCHALTET", "正在关机"},
      {"Saving settings\nPlease wait", "Zapisywanie ustawień\nProszę czekać", "Guardando ajustes\nEspera", "Enregistrement\nPatientez", "Einstellungen speichern\nBitte warten", "正在保存设置\n请稍候"},
      {"1  JOIN WI-FI", "1  POŁĄCZ Z WI-FI", "1  CONECTAR A WI-FI", "1  REJOINDRE LE WI-FI", "1  MIT WLAN VERBINDEN", "1  连接 WI-FI"},
      {"2  OPEN PRINTDECK.LOCAL", "2  OTWÓRZ PRINTDECK.LOCAL", "2  ABRE PRINTDECK.LOCAL", "2  OUVREZ PRINTDECK.LOCAL", "2  PRINTDECK.LOCAL ÖFFNEN", "2  打开 PRINTDECK.LOCAL"},
      {"then", "następnie", "después", "puis", "danach", "然后"},
      {"STEP 1 OF 2", "KROK 1 Z 2", "PASO 1 DE 2", "ÉTAPE 1 SUR 2", "SCHRITT 1 VON 2", "第 1 步，共 2 步"},
      {"STEP 2 OF 2", "KROK 2 Z 2", "PASO 2 DE 2", "ÉTAPE 2 SUR 2", "SCHRITT 2 VON 2", "第 2 步，共 2 步"},
      {"Connect to PrintDeck Wi-Fi", "Połącz z Wi-Fi PrintDeck", "Conéctate al Wi-Fi de PrintDeck", "Connectez-vous au Wi-Fi PrintDeck", "Mit PrintDeck-WLAN verbinden", "连接 PrintDeck Wi-Fi"},
      {"Setup opens automatically", "Konfiguracja otworzy się automatycznie", "La configuración se abrirá automáticamente", "La configuration s’ouvrira automatiquement", "Einrichtung öffnet sich automatisch", "设置将自动打开"},
      {"Scan to join the setup Wi-Fi", "Zeskanuj, aby połączyć się z siecią konfiguracji", "Escanea para conectarte al Wi-Fi de configuración", "Scannez pour rejoindre le Wi-Fi de configuration", "Scannen, um dem Einrichtungs-WLAN beizutreten", "扫码连接设置 Wi-Fi"},
      {"Open PrintDeck Setup", "Otwórz konfigurację PrintDeck", "Abre la configuración de PrintDeck", "Ouvrez la configuration de PrintDeck", "PrintDeck-Einrichtung öffnen", "打开 PrintDeck 设置"},
      {"If setup does not open", "Jeśli konfiguracja się nie otworzy", "Si la configuración no se abre", "Si la configuration ne s’ouvre pas", "Falls sich die Einrichtung nicht öffnet", "如果设置未自动打开"},
      {"Scan to open the configuration page", "Zeskanuj, aby otworzyć stronę konfiguracji", "Escanea para abrir la página de configuración", "Scannez pour ouvrir la page de configuration", "Scannen, um die Konfigurationsseite zu öffnen", "扫码打开配置页面"},
      {"Swipe for the next step", "Przesuń, aby przejść dalej", "Desliza para continuar", "Balayez pour continuer", "Wischen für den nächsten Schritt", "滑动进入下一步"},
      {"Swipe back to reconnect", "Przesuń wstecz, aby połączyć ponownie", "Desliza atrás para volver a conectar", "Balayez en arrière pour vous reconnecter", "Zurückwischen zum erneuten Verbinden", "向回滑动以重新连接"},
      {"SWIPE", "PRZESUŃ", "DESLIZA", "BALAYEZ", "WISCHEN", "滑动"},
      {"SAVED", "ZAPISANA", "GUARDADA", "ENREGISTRÉE", "GESPEICHERT", "已保存"},
      {"UNKNOWN", "NIEZNANA", "DESCONOCIDA", "INCONNUE", "UNBEKANNT", "未知"},
      {"WAIT", "CZEKAJ", "ESPERA", "ATTENDEZ", "WARTEN", "请稍候"},
      {"CONNECTING", "ŁĄCZENIE", "CONECTANDO", "CONNEXION", "VERBINDUNG", "连接中"},
      {"PRINTING", "DRUKOWANIE", "IMPRIMIENDO", "IMPRESSION", "DRUCKT", "打印中"},
      {"PAUSED", "WSTRZYMANO", "PAUSADO", "EN PAUSE", "PAUSIERT", "已暂停"},
      {"DONE", "GOTOWE", "HECHO", "TERMINÉ", "FERTIG", "完成"},
      {"ATTENTION", "UWAGA", "ATENCIÓN", "ATTENTION", "ACHTUNG", "注意"},
      {"READY", "GOTOWA", "LISTA", "PRÊTE", "BEREIT", "就绪"},
      {"No active print", "Brak aktywnego wydruku", "Sin impresión activa", "Aucune impression active", "Kein aktiver Druck", "无活动打印"},
      {"No active file", "Brak aktywnego pliku", "Sin archivo activo", "Aucun fichier actif", "Keine aktive Datei", "无活动文件"},
      {"Klipper ready", "Klipper gotowy", "Klipper listo", "Klipper prêt", "Klipper bereit", "Klipper 已就绪"},
      {"Printer ready", "Drukarka gotowa", "Impresora lista", "Imprimante prête", "Drucker bereit", "打印机已就绪"},
      {"Layer", "Warstwa", "Capa", "Couche", "Schicht", "层"},
      {"SET", "CEL", "OBJ.", "CIBLE", "SOLL", "目标"},
      {"LEFT", "POZOSTAŁO", "RESTANTE", "RESTANT", "RESTZEIT", "剩余"},
      {"PRINT", "WYDRUK", "IMPRESIÓN", "IMPRESSION", "DRUCK", "打印"},
      {"TOTAL", "ŁĄCZNIE", "TOTAL", "TOTAL", "GESAMT", "总计"},
      {"SPEED", "PRĘDKOŚĆ", "VELOCIDAD", "VITESSE", "GESCHW.", "速度"},
      {"FAN", "WENTYLATOR", "VENTILADOR", "VENTILATEUR", "LÜFTER", "风扇"},
      {"PROGRESS", "POSTĘP", "PROGRESO", "PROGRESSION", "FORTSCHRITT", "进度"},
      {"FLOW", "PRZEPŁYW", "FLUJO", "DÉBIT", "FLUSS", "流量"},
      {"LAYER", "WARSTWA", "CAPA", "COUCHE", "SCHICHT", "层"},
      {"NOZZLE TEMP", "TEMP. DYSZY", "TEMP. BOQUILLA", "TEMP. BUSE", "DÜSENTEMP.", "喷嘴温度"},
      {"BED TEMP", "TEMP. STOŁU", "TEMP. CAMA", "TEMP. PLATEAU", "BETTTEMP.", "热床温度"},
      {"CHAMBER", "KOMORA", "CÁMARA", "CHAMBRE", "KAMMER", "腔体"},
      {"ACTUAL / TARGET", "BIEŻĄCA / CEL", "ACTUAL / OBJETIVO", "ACTUEL / CIBLE", "IST / SOLL", "当前 / 目标"},
      {"NOZZLE POWER", "MOC DYSZY", "POTENCIA BOQUILLA", "PUISSANCE BUSE", "DÜSENLEISTUNG", "喷嘴功率"},
      {"BED POWER", "MOC STOŁU", "POTENCIA CAMA", "PUISSANCE PLATEAU", "BETTLEISTUNG", "热床功率"},
      {"HOMED", "BAZA", "REFERENCIADO", "RÉFÉRENCÉ", "REFERENZIERT", "已归零"},
      {"EMPTY", "PUSTA", "VACÍO", "VIDE", "LEER", "空"},
      {"Material", "Materiał", "Material", "Matériau", "Material", "材料"},
      {"External", "Zewnętrzna", "Externa", "Externe", "Extern", "外置"},
      {"External spool", "Zewnętrzna szpula", "Bobina externa", "Bobine externe", "Externe Spule", "外置料盘"},
      {"Not detected", "Nie wykryto", "No detectada", "Non détectée", "Nicht erkannt", "未检测到"},
      {"Snapshots", "Migawki", "Instantáneas", "Instantanés", "Momentaufnahmen", "快照"},
      {"Live", "Na żywo", "En directo", "En direct", "Live", "实时"},
      {"Live local stream", "Lokalny strumień na żywo", "Emisión local en directo", "Flux local en direct", "Lokaler Live-Stream", "本地实时视频"},
      {"Live local snapshot", "Lokalny podgląd na żywo", "Vista local en directo", "Aperçu local en direct", "Lokale Live-Ansicht", "本地实时画面"},
      {"Connecting to the local camera…", "Łączenie z lokalną kamerą…", "Conectando a la cámara local…", "Connexion à la caméra locale…", "Verbindung zur lokalen Kamera…", "正在连接本地摄像头…"},
      {"Detecting camera…", "Wykrywanie kamery…", "Detectando cámara…", "Détection de la caméra…", "Kamera wird erkannt…", "正在检测摄像头…"},
      {"Camera unavailable", "Kamera niedostępna", "Cámara no disponible", "Caméra indisponible", "Kamera nicht verfügbar", "摄像头不可用"},
      {"This display does not support RTSPS cameras", "Ten ekran nie obsługuje kamer RTSPS", "Esta pantalla no admite cámaras RTSPS", "Cet écran ne prend pas en charge les caméras RTSPS", "Dieses Display unterstützt keine RTSPS-Kameras", "此显示设备不支持 RTSPS 摄像头"},
      {"No camera detected\nHave a camera? Contact support.", "Nie wykryto kamery\nMasz kamerę? Skontaktuj się ze wsparciem.", "No se detectó ninguna cámara\n¿Tienes una cámara? Contacta con soporte.", "Aucune caméra détectée\nVous avez une caméra ? Contactez l’assistance.", "Keine Kamera erkannt\nKamera vorhanden? Support kontaktieren.", "未检测到摄像头\n有摄像头？请联系支持。"},
      {"Waiting…", "Oczekiwanie…", "Esperando…", "En attente…", "Warten…", "等待中…"},
      {"Refreshing…", "Odświeżanie…", "Actualizando…", "Actualisation…", "Aktualisieren…", "刷新中…"},
      {"Updated", "Odświeżono", "Actualizada", "Actualisé", "Aktualisiert", "已更新"},
      {"Turning light on…", "Włączanie światła…", "Encendiendo la luz…", "Allumage de la lumière…", "Licht wird eingeschaltet…", "正在开灯…"},
      {"Turning light off…", "Wyłączanie światła…", "Apagando la luz…", "Extinction de la lumière…", "Licht wird ausgeschaltet…", "正在关灯…"},
      {"TURNING ON", "WŁĄCZANIE", "ENCENDIENDO", "ALLUMAGE", "EINSCHALTEN", "正在开启"},
      {"TURNING OFF", "WYŁĄCZANIE", "APAGANDO", "EXTINCTION", "AUSSCHALTEN", "正在关闭"},
      {"Light is on", "Światło jest włączone", "La luz está encendida", "La lumière est allumée", "Licht ist an", "灯已开启"},
      {"Light is off", "Światło jest wyłączone", "La luz está apagada", "La lumière est éteinte", "Licht ist aus", "灯已关闭"},
      {"Light status unavailable", "Stan światła niedostępny", "Estado de luz no disponible", "État de la lumière indisponible", "Lichtstatus nicht verfügbar", "灯光状态不可用"},
      {"TURN OFF", "WYŁĄCZ", "APAGAR", "ÉTEINDRE", "AUSSCHALTEN", "关闭"},
      {"TURN ON", "WŁĄCZ", "ENCENDER", "ALLUMER", "EINSCHALTEN", "开启"},
      {"UNAVAILABLE", "NIEDOSTĘPNE", "NO DISPONIBLE", "INDISPONIBLE", "NICHT VERFÜGBAR", "不可用"},
      {"Waiting for network time", "Oczekiwanie na czas z sieci", "Esperando la hora de red", "Attente de l’heure réseau", "Warte auf Netzwerkzeit", "正在等待网络时间"},
      {"TIME NOT SYNCED", "CZAS NIEZSYNCHRONIZOWANY", "HORA NO SINCRONIZADA", "HEURE NON SYNCHRONISÉE", "ZEIT NICHT SYNCHRONISIERT", "时间未同步"},
      {"Sunday", "Niedziela", "Domingo", "Dimanche", "Sonntag", "星期日"},
      {"Monday", "Poniedziałek", "Lunes", "Lundi", "Montag", "星期一"},
      {"Tuesday", "Wtorek", "Martes", "Mardi", "Dienstag", "星期二"},
      {"Wednesday", "Środa", "Miércoles", "Mercredi", "Mittwoch", "星期三"},
      {"Thursday", "Czwartek", "Jueves", "Jeudi", "Donnerstag", "星期四"},
      {"Friday", "Piątek", "Viernes", "Vendredi", "Freitag", "星期五"},
      {"Saturday", "Sobota", "Sábado", "Samedi", "Samstag", "星期六"},
      {"Sun", "Nd", "Dom", "Dim", "So", "周日"},
      {"Mon", "Pon", "Lun", "Lun", "Mo", "周一"},
      {"Tue", "Wt", "Mar", "Mar", "Di", "周二"},
      {"Wed", "Śr", "Mié", "Mer", "Mi", "周三"},
      {"Thu", "Czw", "Jue", "Jeu", "Do", "周四"},
      {"Fri", "Pt", "Vie", "Ven", "Fr", "周五"},
      {"Sat", "Sob", "Sáb", "Sam", "Sa", "周六"},
      {"New", "Nowa", "Nueva", "Nouvelle", "Neu", "新版本"},
      {"Installed", "Zainstalowana", "Instalada", "Installée", "Installiert", "已安装"},
      {"Downloading", "Pobieranie", "Descargando", "Téléchargement", "Download", "下载中"},
      {"Standby", "Gotowa", "En espera", "En veille", "Bereit", "待机"},
      {"Preparing", "Przygotowanie", "Preparando", "Préparation", "Vorbereitung", "准备中"},
      {"Heating nozzle", "Nagrzewanie dyszy", "Calentando boquilla", "Chauffage de la buse", "Düse wird aufgeheizt", "正在加热喷嘴"},
      {"Heating bed", "Nagrzewanie stołu", "Calentando la cama", "Chauffage du plateau", "Heizbett wird aufgeheizt", "正在加热热床"},
      {"Homing toolhead", "Bazowanie głowicy", "Referenciando el cabezal", "Référencement de la tête", "Werkzeugkopf wird referenziert", "正在归零工具头"},
      {"Leveling the bed", "Poziomowanie stołu", "Nivelando la cama", "Nivellement du plateau", "Druckbett wird nivelliert", "正在调平热床"},
      {"Cleaning nozzle", "Czyszczenie dyszy", "Limpiando la boquilla", "Nettoyage de la buse", "Düse wird gereinigt", "正在清洁喷嘴"},
      {"Calibrating", "Kalibracja", "Calibrando", "Étalonnage", "Kalibrierung", "正在校准"},
      {"Changing filament", "Zmiana filamentu", "Cambiando filamento", "Changement de filament", "Filamentwechsel", "正在更换耗材"},
      {"Unloading filament", "Wycofywanie filamentu", "Descargando filamento", "Retrait du filament", "Filament wird entladen", "正在退料"},
      {"Loading filament", "Ładowanie filamentu", "Cargando filamento", "Chargement du filament", "Filament wird geladen", "正在进料"},
      {"Purging filament", "Czyszczenie filamentu", "Purgando filamento", "Purge du filament", "Filament wird gespült", "正在冲刷耗材"},
      {"Printing", "Drukowanie", "Imprimiendo", "Impression", "Druckt", "打印中"},
      {"Calibration", "Kalibracja", "Calibración", "Étalonnage", "Kalibrierung", "校准中"},
      {"Printer calibration", "Kalibracja drukarki", "Calibración de la impresora", "Étalonnage de l’imprimante", "Druckerkalibrierung", "打印机校准"},
      {"Paused", "Wstrzymano", "Pausado", "En pause", "Pausiert", "已暂停"},
      {"Complete", "Zakończono", "Completado", "Terminée", "Abgeschlossen", "已完成"},
      {"Failed", "Błąd", "Fallido", "Échec", "Fehlgeschlagen", "失败"},
      {"Cancelled", "Anulowano", "Cancelado", "Annulée", "Abgebrochen", "已取消"},
      {"Unavailable", "Niedostępna", "No disponible", "Indisponible", "Nicht verfügbar", "不可用"},
      {"STANDBY", "GOTOWA", "EN ESPERA", "EN VEILLE", "BEREIT", "待机"},
      {"PREPARING", "PRZYGOTOWANIE", "PREPARANDO", "PRÉPARATION", "VORBEREITUNG", "准备中"},
      {"CALIBRATION", "KALIBRACJA", "CALIBRACIÓN", "ÉTALONNAGE", "KALIBRIERUNG", "校准中"},
      {"COMPLETE", "ZAKOŃCZONO", "COMPLETADO", "TERMINÉE", "ABGESCHLOSSEN", "已完成"},
      {"FAILED", "BŁĄD", "FALLIDO", "ÉCHEC", "FEHLGESCHLAGEN", "失败"},
      {"CANCELLED", "ANULOWANO", "CANCELADO", "ANNULÉE", "ABGEBROCHEN", "已取消"},
      {"Not selected", "Nie wybrano", "No seleccionada", "Non sélectionnée", "Nicht ausgewählt", "未选择"},
      {"Waiting for network", "Oczekiwanie na sieć", "Esperando la red", "Attente du réseau", "Warte auf Netzwerk", "正在等待网络"},
      {"Connecting", "Łączenie", "Conectando", "Connexion", "Verbindung", "连接中"},
      {"Online", "Online", "En línea", "En ligne", "Online", "在线"},
      {"Connection failed", "Błąd połączenia", "Error de conexión", "Échec de connexion", "Verbindung fehlgeschlagen", "连接失败"},
      {"Starting local network search…", "Rozpoczynanie wyszukiwania w sieci lokalnej…", "Iniciando búsqueda en la red local…", "Démarrage de la recherche sur le réseau local…", "Lokale Netzwerksuche wird gestartet…", "正在开始本地网络搜索…"},
      {"PrintDeck could not start the network search. Please try again.", "Nie udało się rozpocząć wyszukiwania w sieci. Spróbuj ponownie.", "PrintDeck no pudo iniciar la búsqueda. Inténtalo de nuevo.", "PrintDeck n’a pas pu lancer la recherche. Réessayez.", "PrintDeck konnte die Netzwerksuche nicht starten. Bitte erneut versuchen.", "PrintDeck 无法开始网络搜索。请重试。"},
      {"Looking for supported printers…", "Wyszukiwanie obsługiwanych drukarek…", "Buscando impresoras compatibles…", "Recherche d’imprimantes compatibles…", "Suche nach unterstützten Druckern…", "正在查找支持的打印机…"},
      {"PrintDeck could not determine the current Wi-Fi network.", "Nie udało się ustalić bieżącej sieci Wi‑Fi.", "PrintDeck no pudo determinar la red Wi‑Fi actual.", "PrintDeck n’a pas pu déterminer le réseau Wi‑Fi actuel.", "PrintDeck konnte das aktuelle WLAN nicht ermitteln.", "PrintDeck 无法确定当前 Wi-Fi 网络。"},
      {"Network search stopped.", "Wyszukiwanie w sieci zatrzymane.", "Búsqueda de red detenida.", "Recherche réseau arrêtée.", "Netzwerksuche gestoppt.", "网络搜索已停止。"},
      {"The 3-minute safety limit was reached before a supported printer responded.", "Osiągnięto 3-minutowy limit, zanim odpowiedziała obsługiwana drukarka.", "Se alcanzó el límite de 3 minutos antes de que respondiera una impresora compatible.", "La limite de 3 minutes a été atteinte avant la réponse d’une imprimante compatible.", "Das 3-Minuten-Limit wurde erreicht, bevor ein unterstützter Drucker antwortete.", "在支持的打印机响应前已达到 3 分钟安全限制。"},
      {"Network search complete. Results found before the safety limit are shown.", "Wyszukiwanie zakończone. Pokazano wyniki znalezione przed upływem limitu.", "Búsqueda completada. Se muestran los resultados encontrados antes del límite.", "Recherche terminée. Les résultats trouvés avant la limite sont affichés.", "Netzwerksuche abgeschlossen. Vor dem Limit gefundene Ergebnisse werden angezeigt.", "网络搜索完成。已显示安全限制前找到的结果。"},
      {"The network was busy, so the search could not be completed. Try again.", "Sieć była zajęta i nie udało się dokończyć wyszukiwania. Spróbuj ponownie.", "La red estaba ocupada y no se pudo completar la búsqueda. Inténtalo de nuevo.", "Le réseau était occupé et la recherche n’a pas pu aboutir. Réessayez.", "Das Netzwerk war ausgelastet; die Suche konnte nicht abgeschlossen werden. Erneut versuchen.", "网络繁忙，无法完成搜索。请重试。"},
      {"Network search complete. Available printers are shown.", "Wyszukiwanie zakończone. Pokazano dostępne drukarki.", "Búsqueda completada. Se muestran las impresoras disponibles.", "Recherche terminée. Les imprimantes disponibles sont affichées.", "Netzwerksuche abgeschlossen. Verfügbare Drucker werden angezeigt.", "网络搜索完成。已显示可用打印机。"},
      {"Contacting your printer…", "Łączenie z drukarką…", "Contactando con la impresora…", "Connexion à l’imprimante…", "Drucker wird kontaktiert…", "正在联系打印机…"},
      {"Checking the Moonraker service…", "Sprawdzanie usługi Moonraker…", "Comprobando el servicio Moonraker…", "Vérification du service Moonraker…", "Moonraker-Dienst wird geprüft…", "正在检查 Moonraker 服务…"},
      {"Moonraker is connected, but the printer identity was not recognized.", "Połączono z Moonraker, ale nie rozpoznano drukarki.", "Moonraker está conectado, pero no se reconoció la impresora.", "Moonraker est connecté, mais l’imprimante n’a pas été reconnue.", "Moonraker ist verbunden, aber der Drucker wurde nicht erkannt.", "Moonraker 已连接，但未识别打印机身份。"},
      {"Preparing the read-only BambuLab probe", "Przygotowywanie testu Bambu Lab tylko do odczytu", "Preparando la prueba de solo lectura de Bambu Lab", "Préparation du test Bambu Lab en lecture seule", "Schreibgeschützte Bambu-Lab-Prüfung wird vorbereitet", "正在准备 Bambu Lab 只读检测"},
      {"Preparing the Bambu Lab connection test", "Przygotowywanie testu połączenia z Bambu Lab", "Preparando la prueba de conexión con Bambu Lab", "Préparation du test de connexion Bambu Lab", "Bambu-Lab-Verbindungstest wird vorbereitet", "正在准备 Bambu Lab 连接测试"},
      {"Bambu Lab connection verified.", "Połączenie z Bambu Lab zostało sprawdzone.", "Conexión con Bambu Lab verificada.", "Connexion Bambu Lab vérifiée.", "Bambu-Lab-Verbindung bestätigt.", "Bambu Lab 连接已验证。"},
      {"The printer answered, but it did not accept these connection details.", "Drukarka odpowiedziała, ale nie zaakceptowała tych danych połączenia.", "La impresora respondió, pero no aceptó estos datos de conexión.", "L’imprimante a répondu, mais n’a pas accepté ces informations de connexion.", "Der Drucker hat geantwortet, diese Verbindungsdaten jedoch nicht akzeptiert.", "打印机已响应，但未接受这些连接信息。"},
      {"PrintDeck could not reach this Bambu Lab printer. Check the address, LAN access code and Wi-Fi network.", "PrintDeck nie mógł połączyć się z tą drukarką Bambu Lab. Sprawdź adres, kod dostępu LAN i sieć Wi‑Fi.", "PrintDeck no pudo acceder a esta impresora Bambu Lab. Comprueba la dirección, el código de acceso LAN y la red Wi‑Fi.", "PrintDeck n’a pas pu joindre cette imprimante Bambu Lab. Vérifiez l’adresse, le code d’accès LAN et le réseau Wi-Fi.", "PrintDeck konnte diesen Bambu-Lab-Drucker nicht erreichen. Adresse, LAN-Zugangscode und WLAN prüfen.", "PrintDeck 无法连接此 Bambu Lab 打印机。请检查地址、LAN 访问码和 Wi-Fi 网络。"},
      {"The compatibility worker could not be started", "Nie udało się uruchomić testu zgodności", "No se pudo iniciar la prueba de compatibilidad", "Le test de compatibilité n’a pas pu démarrer", "Kompatibilitätsprüfung konnte nicht gestartet werden", "无法启动兼容性检查"},
      {"Checking optional local file service", "Sprawdzanie opcjonalnej lokalnej usługi plików", "Comprobando el servicio local de archivos opcional", "Vérification du service de fichiers local facultatif", "Optionaler lokaler Dateidienst wird geprüft", "正在检查可选的本地文件服务"},
      {"Compatibility check cancelled", "Sprawdzanie zgodności anulowane", "Comprobación de compatibilidad cancelada", "Vérification de compatibilité annulée", "Kompatibilitätsprüfung abgebrochen", "兼容性检查已取消"},
      {"Compatibility report ready to download", "Raport zgodności jest gotowy do pobrania", "Informe de compatibilidad listo para descargar", "Rapport de compatibilité prêt à télécharger", "Kompatibilitätsbericht steht zum Download bereit", "兼容性报告可供下载"},
      {"No MQTT report was received; a partial service report is ready", "Nie odebrano raportu MQTT; dostępny jest częściowy raport usług", "No se recibió informe MQTT; hay un informe parcial disponible", "Aucun rapport MQTT reçu ; un rapport partiel est disponible", "Kein MQTT-Bericht empfangen; ein Teilbericht ist verfügbar", "未收到 MQTT 报告；部分服务报告已就绪"},
      {"Checking for a newer PrintDeck release...", "Sprawdzanie nowszego wydania PrintDeck...", "Buscando una versión más reciente de PrintDeck...", "Recherche d’une version plus récente de PrintDeck...", "Suche nach einer neueren PrintDeck-Version...", "正在检查较新的 PrintDeck 版本..."},
      {"Receiving and validating the firmware image...", "Odbieranie i sprawdzanie obrazu firmware...", "Recibiendo y validando la imagen de firmware...", "Réception et validation de l’image du micrologiciel...", "Firmware-Abbild wird empfangen und geprüft...", "正在接收并验证固件镜像..."},
      {"Firmware installed. Restarting PrintDeck...", "Firmware zainstalowane. Ponowne uruchamianie PrintDeck...", "Firmware instalado. Reiniciando PrintDeck...", "Micrologiciel installé. Redémarrage de PrintDeck...", "Firmware installiert. PrintDeck wird neu gestartet...", "固件已安装。正在重启 PrintDeck..."},
      {"Preparing the firmware update...", "Przygotowywanie aktualizacji firmware...", "Preparando la actualización de firmware...", "Préparation de la mise à jour du micrologiciel...", "Firmware-Aktualisierung wird vorbereitet...", "正在准备固件更新..."},
      {"Preparing the firmware from the supplied HTTPS address...", "Przygotowywanie firmware z podanego adresu HTTPS...", "Preparando el firmware desde la dirección HTTPS indicada...", "Préparation du micrologiciel depuis l’adresse HTTPS fournie...", "Firmware von der angegebenen HTTPS-Adresse wird vorbereitet...", "正在从提供的 HTTPS 地址准备固件..."},
      {"A newer PrintDeck release is ready.", "Dostępne jest nowsze wydanie PrintDeck.", "Hay una versión más reciente de PrintDeck.", "Une version plus récente de PrintDeck est disponible.", "Eine neuere PrintDeck-Version ist verfügbar.", "有较新的 PrintDeck 版本可用。"},
      {"PrintDeck is up to date.", "PrintDeck jest aktualny.", "PrintDeck está actualizado.", "PrintDeck est à jour.", "PrintDeck ist aktuell.", "PrintDeck 已是最新版本。"},
      {"Downloading and validating the update...", "Pobieranie i sprawdzanie aktualizacji...", "Descargando y validando la actualización...", "Téléchargement et validation de la mise à jour...", "Update wird heruntergeladen und geprüft...", "正在下载并验证更新..."},
      {"Update installed. Restarting PrintDeck...", "Aktualizacja zainstalowana. Ponowne uruchamianie PrintDeck...", "Actualización instalada. Reiniciando PrintDeck...", "Mise à jour installée. Redémarrage de PrintDeck...", "Update installiert. PrintDeck wird neu gestartet...", "更新已安装。正在重启 PrintDeck..."},
      {"PrintDeck could not create the update request.", "Nie udało się utworzyć żądania aktualizacji.", "PrintDeck no pudo crear la solicitud de actualización.", "PrintDeck n’a pas pu créer la demande de mise à jour.", "PrintDeck konnte die Update-Anfrage nicht erstellen.", "PrintDeck 无法创建更新请求。"},
      {"The update response was too large.", "Odpowiedź aktualizacji była zbyt duża.", "La respuesta de actualización era demasiado grande.", "La réponse de mise à jour était trop volumineuse.", "Die Update-Antwort war zu groß.", "更新响应过大。"},
      {"PrintDeck could not reach the update service.", "Nie udało się połączyć z usługą aktualizacji.", "PrintDeck no pudo acceder al servicio de actualización.", "PrintDeck n’a pas pu joindre le service de mise à jour.", "PrintDeck konnte den Update-Dienst nicht erreichen.", "PrintDeck 无法连接更新服务。"},
      {"The update service returned a non-production release.", "Usługa aktualizacji zwróciła wydanie nieprodukcyjne.", "El servicio devolvió una versión no destinada a producción.", "Le service a renvoyé une version hors production.", "Der Update-Dienst lieferte ein nicht produktives Release.", "更新服务返回了非正式版本。"},
      {"The release does not contain a valid PrintDeck version.", "Wydanie nie zawiera prawidłowej wersji PrintDeck.", "La versión no contiene una versión válida de PrintDeck.", "La version ne contient pas de version PrintDeck valide.", "Das Release enthält keine gültige PrintDeck-Version.", "该版本不包含有效的 PrintDeck 版本号。"},
      {"The release does not contain a matching PrintDeck firmware image.", "Wydanie nie zawiera pasującego obrazu firmware PrintDeck.", "La versión no contiene una imagen de firmware PrintDeck compatible.", "La version ne contient pas d’image de micrologiciel PrintDeck correspondante.", "Das Release enthält kein passendes PrintDeck-Firmware-Abbild.", "该版本不包含匹配的 PrintDeck 固件镜像。"},
      {"The latest PrintDeck release does not include firmware for this hardware.", "Najnowsze wydanie PrintDeck nie zawiera firmware dla tego sprzętu.", "La última versión de PrintDeck no incluye firmware para este hardware.", "La dernière version de PrintDeck n’inclut pas de micrologiciel pour ce matériel.", "Das neueste PrintDeck-Release enthält keine Firmware für diese Hardware.", "最新的 PrintDeck 版本不包含适用于此硬件的固件。"},
      {"The firmware update could not start.", "Nie udało się rozpocząć aktualizacji firmware.", "No se pudo iniciar la actualización de firmware.", "La mise à jour du micrologiciel n’a pas pu démarrer.", "Die Firmware-Aktualisierung konnte nicht gestartet werden.", "无法启动固件更新。"},
      {"The firmware download was incomplete.", "Pobieranie firmware nie zostało ukończone.", "La descarga del firmware quedó incompleta.", "Le téléchargement du micrologiciel était incomplet.", "Der Firmware-Download war unvollständig.", "固件下载不完整。"},
      {"The downloaded firmware did not pass validation.", "Pobrane firmware nie przeszło weryfikacji.", "El firmware descargado no superó la validación.", "Le micrologiciel téléchargé n’a pas été validé.", "Die heruntergeladene Firmware bestand die Prüfung nicht.", "下载的固件未通过验证。"},
      {"Install the new firmware securely over Wi-Fi.\nKeep PrintDeck powered until it restarts.", "Zainstaluj nowe firmware bezpiecznie przez Wi‑Fi.\nPozostaw PrintDeck podłączony do zasilania aż do restartu.", "Instala el nuevo firmware de forma segura por Wi‑Fi.\nMantén PrintDeck encendido hasta que se reinicie.", "Installez le nouveau micrologiciel en toute sécurité par Wi‑Fi.\nGardez PrintDeck alimenté jusqu’au redémarrage.", "Neue Firmware sicher über WLAN installieren.\nPrintDeck bis zum Neustart mit Strom versorgen.", "通过 Wi-Fi 安全安装新固件。\n请保持 PrintDeck 供电直至重启。"},
      {"Settings need attention", "Ustawienia wymagają uwagi", "Los ajustes requieren atención", "Les paramètres nécessitent votre attention", "Einstellungen erfordern Aufmerksamkeit", "设置需要处理"},
      {"Network startup failed", "Nie udało się uruchomić sieci", "No se pudo iniciar la red", "Le démarrage du réseau a échoué", "Netzwerkstart fehlgeschlagen", "网络启动失败"},
      {"Web Config startup failed", "Nie udało się uruchomić Web Config", "No se pudo iniciar Web Config", "Le démarrage de Web Config a échoué", "Web Config konnte nicht gestartet werden", "Web Config 启动失败"},
      {"Display service unavailable\nOpen Web Config to restart", "Usługa ekranu niedostępna\nOtwórz Web Config, aby uruchomić ponownie", "Servicio de pantalla no disponible\nAbre Web Config para reiniciar", "Service d’affichage indisponible\nOuvrez Web Config pour redémarrer", "Display-Dienst nicht verfügbar\nWeb Config zum Neustart öffnen", "显示服务不可用\n打开 Web Config 以重启"},
      {"Connecting to Wi-Fi", "Łączenie z Wi‑Fi", "Conectando a Wi‑Fi", "Connexion au Wi‑Fi", "WLAN-Verbindung", "正在连接 Wi-Fi"},
      {"saved network", "zapisana sieć", "red guardada", "réseau enregistré", "gespeichertes Netzwerk", "已保存的网络"},
      {"Could not connect to Wi-Fi", "Nie udało się połączyć z Wi‑Fi", "No se pudo conectar a Wi‑Fi", "Connexion au Wi‑Fi impossible", "WLAN-Verbindung fehlgeschlagen", "无法连接 Wi-Fi"},
      {"Opening Wi-Fi Setup...", "Otwieranie konfiguracji Wi‑Fi...", "Abriendo la configuración Wi‑Fi...", "Ouverture de la configuration Wi‑Fi...", "WLAN-Einrichtung wird geöffnet...", "正在打开 Wi-Fi 设置..."},
      {"remaining", "pozostało", "restantes", "restant", "verbleibend", "剩余"},
      {"Local printer telemetry", "Lokalna telemetria drukarki", "Telemetría local de la impresora", "Télémétrie locale de l’imprimante", "Lokale Druckertelemetrie", "本地打印机遥测"},
      {"NOT NOW", "NIE TERAZ", "AHORA NO", "PAS MAINTENANT", "NICHT JETZT", "暂不"},
      {"Ready to check for updates.", "Gotowe do sprawdzenia aktualizacji.", "Listo para buscar actualizaciones.", "Prêt à rechercher des mises à jour.", "Bereit zur Suche nach Updates.", "可以检查更新。"},
  };
  const int column = language == "pl" ? 1 : language == "es" ? 2 : language == "fr" ? 3 :
                     language == "de" ? 4 : language == "zh-CN" ? 5 : 0;
  for (const Entry& entry : entries) {
    if (english == entry.en) {
      const char* values[]{entry.en, entry.pl, entry.es, entry.fr, entry.de, entry.zh};
      return values[column];
    }
  }
  return english.data();
}

}  // namespace printdeck::core
